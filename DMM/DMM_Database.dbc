VERSION ""

NS_ :

BS_:

BU_:
VAL_TABLE_ Folding_VT 1 "Folding" 0 "Open" ;
VAL_TABLE_ Movement_VT 4 "Moving Down" 3 "Moving Up" 2 "Moving Right" 1 "Moving Left" 0 "Stationary" ;
VAL_TABLE_ BS_VT 3 "Vehicle in both blind spot" 2 "Vehicle in right blind spot" 1 "Vehicle in left blind spot" 0 "Vehicle not in blind spot" ;
VAL_TABLE_ Door_VT 1 "Door Close" 0 "Dooor Open" ;

BO_ 773 Mirror_Folding: 1 Vector__XXX
 SG_ Folding : 0|1@1+ (1,0) [0|1] "" Vector__XXX

BO_ 770 Blind_Spot: 1 Vector__XXX
 SG_ Blind_Spot : 0|2@1+ (1,0) [0|3] "" Vector__XXX

BO_ 771 Right_Mirror: 1 Vector__XXX
 SG_ Movement : 0|3@1+ (1,0) [0|4] "" Vector__XXX

BO_ 772 Left_Mirror: 1 Vector__XXX
 SG_ Movement : 0|3@1+ (1,0) [0|4] "" Vector__XXX

BO_ 769 Door_Lock: 1 Vector__XXX
 SG_ Door_Status : 0|1@1+ (1,0) [0|1] "" Vector__XXX

VAL_ 773 Folding 1 "Folding" 0 "Open" ;
VAL_ 770 Blind_Spot 3 "Vehicle in both blind spot" 2 "Vehicle in right blind spot" 1 "Vehicle in left blind spot" 0 "Vehicle not in blind spot" ;
VAL_ 771 Movement 4 "Moving Down" 3 "Moving Up" 2 "Moving Right" 1 "Moving Left" 0 "Stationary" ;
VAL_ 772 Movement 4 "Moving Right" 3 "Moving Left" 2 "Moving Down" 1 "Moving Up" 0 "Stationary" ;
VAL_ 769 Door_Status 1 "Door Lock" 0 "Dooor Unlock" ;
