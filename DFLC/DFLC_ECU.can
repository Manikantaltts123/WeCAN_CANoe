/*@!Encoding:1252*/
includes
{
  
}

variables
{
  message Indicator_Lights_Message ilm;
  message HeadLight_Message hlm;
  message Vehicle_Motion vm;
  msTimer timer_vm;
  int light_value, rain_value, Ignition_Value, Gear_Value;
}
on start
{
  vm.Engine_Status=1;
  output(vm);
  output(hlm);
  output(ilm);
  setTimer(timer_vm,200);
  //@Piston=0;
}
on timer timer_vm
{
//  if(@Piston==16)
//  {
//    @Piston=0;
//  }
//  else{
//    @Piston++;
//  }
  output(vm);
  output(hlm);
  output(ilm);
  setTimer(timer_vm,200);
}
on message Acceleraton_Message
{
  if((Ignition_Value > 1) && (Gear_Value == 1)){
    vm.Vehicle_Speed = this.Acceleration_Signal;
    if(vm.Vehicle_Speed < 500)
    {
      if(light_value < 3){
        hlm.High_Beam_Signal = 0;
        hlm.Low_Beam_Signal = 1;
      }
      else if(light_value > 3)
      {
        hlm.Low_Beam_Signal = 0;
        hlm.High_Beam_Signal = 0;
      }
    }
    else if (vm.Vehicle_Speed >= 500)
    {
      if(light_value < 3){
        hlm.Low_Beam_Signal = 0;
        hlm.High_Beam_Signal = 1;
      }
      else if(light_value > 3)
      {
        hlm.Low_Beam_Signal = 0;
        hlm.High_Beam_Signal = 0;
      }
    }
    if(rain_value < 3)
    {
      hlm.Fog_Beam_Signal = 1;
    }
    else{
      hlm.Fog_Beam_Signal = 0;
    }
  }
  else{
    vm.Vehicle_Speed = 0;
  }
}

on message Brake_Message
{
  if(this.Brake_Signal == 1)
  {
    vm.Vehicle_Speed=0;
  }
}
on message Sensor_Message
{
  light_value = this.Light_Sensor_Signal;
  rain_value = this.Rain_Sensor_Signal;
  
}
on message Steering_Wheel_Message
{
  if(this.Steering_Wheel_Signal > 110){
    ilm.Left_Light_Status = 0;
    ilm.Right_Light_Status = 1;
  }
  else if(this.Steering_Wheel_Signal < 60){
    ilm.Left_Light_Status = 1;
    ilm.Right_Light_Status = 0;
  }
  else{
    ilm.Left_Light_Status = 0;
    ilm.Right_Light_Status = 0;
  }
}
on message Ignition_Key
{
  Ignition_Value = this.Ignition_Key_Status;
}
on message Gear_Status
{
  Gear_Value = this.Gear_State;
}